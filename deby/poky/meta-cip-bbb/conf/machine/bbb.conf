## deby/poky/meta-cip-bbb/conf/machine/bbb.conf
```bitbake
# Copyright (C) 2016-2017, TOSHIBA Corp., Daniel Sangorrin <daniel.sangorrin@toshiba.co.jp>
# SPDX-License-Identifier:	MIT

#@TYPE: Machine
#@NAME: BBB (beaglebone black)
#@DESCRIPTION: Machine configuration for running Deby on the BBB

DEFAULTTUNE ?= "cortexa8hf-neon"
require conf/machine/include/tune-cortexa8.inc

SERIAL_CONSOLE = "115200 ttyO0"
IMAGE_FSTYPES ?= "tar.gz cpio.gz cpio.gz.u-boot"
IMAGE_CLASSES += "image_types_uboot"
```

## deby/poky/meta-cip-cyclonev/conf/machine/cyclonev.conf
```bitbake
# Copyright (C) 2016-2017, TOSHIBA Corp., Daniel Sangorrin <daniel.sangorrin@toshiba.co.jp>
# SPDX-License-Identifier:	MIT

#@TYPE: Machine
#@NAME: Cyclone V board
#@DESCRIPTION: Machine configuration for running Deby on cyclone V

require conf/machine/include/tune-cortexa9.inc
DEFAULTTUNE ?= "cortexa9hf-neon"

SERIAL_CONSOLE = "115200 ttyS0"
IMAGE_FSTYPES ?= "tar.gz cpio.gz cpio.gz.u-boot"
IMAGE_CLASSES += "image_types_uboot"
```

## deby/poky/meta-cip-iwg20m/conf/machine/iwg20m.conf
```bitbake
#@TYPE: Machine
#@NAME: iWave RZ/G1M Qseven development platforms
#@DESCRIPTION: Machine configuration for running on iwg20m

DEFAULTTUNE ?= "cortexa15"
require conf/machine/include/tune-cortexa15.inc

SERIAL_CONSOLE = "115200 ttySC0"
IMAGE_FSTYPES ?= "tar.gz cpio.gz cpio.gz.u-boot"
IMAGE_CLASSES += "image_types_uboot"
```

## deby/poky/meta-cip-qemux86-64/conf/machine/pc64.conf
```bitbake
# Copyright (C) 2016-2017, TOSHIBA Corp., Daniel Sangorrin <daniel.sangorrin@toshiba.co.jp>
# SPDX-License-Identifier:	MIT

#@TYPE: Machine
#@NAME: common_pc
#@DESCRIPTION: Machine configuration for running a common x86

DEFAULTTUNE ?= "core2-64"
require conf/machine/include/tune-core2.inc

SERIAL_CONSOLE = "115200 ttyS0"
KERNEL_IMAGETYPE = "bzImage"
IMAGE_FSTYPES = "tar.gz"

MACHINE_FEATURES += "x86"
```

## poky/meta-cip-bbb/conf/layer.conf
```bitbake
# Copyright (C) 2016-2017, TOSHIBA Corp., Daniel Sangorrin <daniel.sangorrin@toshiba.co.jp>
# SPDX-License-Identifier:      MIT

# We have a conf and classes directory, add to BBPATH
BBPATH =. "${LAYERDIR}:"

# We have recipes-* directories, add to BBFILES
BBFILES += "${LAYERDIR}/recipes-*/*/*.bb \
            ${LAYERDIR}/recipes-*/*/*.bbappend"

BBFILE_COLLECTIONS += "bbb"
BBFILE_PATTERN_bbb = "^${LAYERDIR}/"
BBFILE_PRIORITY_bbb = "13"

# This should only be incremented on significant changes that will
# cause compatibility issues with other layers
LAYERVERSION_bbb = "1"
LAYERDEPENDS_bbb = "cip-common"
```

## poky/meta-cip-common/conf/layer.conf
```bitbake
# Copyright (C) 2016-2018, TOSHIBA Corp., Daniel Sangorrin <daniel.sangorrin@toshiba.co.jp>
# SPDX-License-Identifier:	MIT

# We have a conf and classes directory, add to BBPATH
BBPATH =. "${LAYERDIR}:"

# We have recipes-* directories, add to BBFILES
BBFILES += "${LAYERDIR}/recipes-*/*/*.bb \
            ${LAYERDIR}/recipes-*/*/*.bbappend"

BBFILE_COLLECTIONS += "cip-common"
BBFILE_PATTERN_cip-common = "^${LAYERDIR}/"
BBFILE_PRIORITY_cip-common = "12"

# This should only be incremented on significant changes that will
# cause compatibility issues with other layers
LAYERVERSION_cip-common = "1"
LAYERDEPENDS_cip-common = "debian"
```

## poky/meta-cip-iwg20m/conf/layer.conf
```bitbake
# Copyright (C) 2016-2017, TOSHIBA Corp., Daniel Sangorrin <daniel.sangorrin@toshiba.co.jp>
# SPDX-License-Identifier:      MIT

# We have a conf and classes directory, add to BBPATH
BBPATH =. "${LAYERDIR}:"

# We have recipes-* directories, add to BBFILES
BBFILES += "${LAYERDIR}/recipes-*/*/*.bb \
            ${LAYERDIR}/recipes-*/*/*.bbappend"

BBFILE_COLLECTIONS += "iwg20m"
BBFILE_PATTERN_iwg20m = "^${LAYERDIR}/"
BBFILE_PRIORITY_iwg20m = "13"

# This should only be incremented on significant changes that will
# cause compatibility issues with other layers
LAYERVERSION_iwg20m = "1"
LAYERDEPENDS_iwg20m = "cip-common"
```

## poky/meta-cip-qemux86-64/conf/layer.conf
```bitbake
# Copyright (C) 2016-2017, TOSHIBA Corp., Daniel Sangorrin <daniel.sangorrin@toshiba.co.jp>
# SPDX-License-Identifier:      MIT

# We have a conf and classes directory, add to BBPATH
BBPATH =. "${LAYERDIR}:"

# We have recipes-* directories, add to BBFILES
BBFILES += "${LAYERDIR}/recipes-*/*/*.bb \
            ${LAYERDIR}/recipes-*/*/*.bbappend"

BBFILE_COLLECTIONS += "cip-qemux86-64"
BBFILE_PATTERN_cip-qemux86-64 = "^${LAYERDIR}/"
BBFILE_PRIORITY_cip-qemux86-64 = "13"

# This should only be incremented on significant changes that will
# cause compatibility issues with other layers
LAYERVERSION_cip-qemux86-64 = "1"
LAYERDEPENDS_cip-qemux86-64 = "cip-common"
```

## poky/meta-cip-sr-imx8mnc/conf/layer.conf
```bitbake
# Copyright (C) 2016-2017, Solidrun, Eric Bree <eric.bree@solid-run.com>
# SPDX-License-Identifier:	MIT

# We have a conf and classes directory, add to BBPATH
BBPATH =. "${LAYERDIR}:"

# We have recipes-* directories, add to BBFILES
BBFILES += "${LAYERDIR}/recipes-*/*/*.bb \
            ${LAYERDIR}/recipes-*/*/*.bbappend"

BBFILE_COLLECTIONS += "sr-imx8mnc"
BBFILE_PATTERN_sr-imx8mnc = "^${LAYERDIR}/"
BBFILE_PRIORITY_sr-imx8mnc = "13"

# This should only be incremented on significant changes that will
# cause compatibility issues with other layers
LAYERVERSION_sr-imx8mnc = "1"
LAYERDEPENDS_sr-imx8mnc = "cip-common"

LAYERSERIES_COMPAT_sr-imx8mnc = "dunfell warrior mortyi zeus"

# Should be in meta-cip-common/conf/layer.conf, this is a workaround to avoid changing files in
# meta-cip-common
LAYERSERIES_COMPAT_cip-common = "dunfell warrior morty zeus"
```

## poky/meta-cip-sr-in6gsdl/conf/layer.conf
```bitbake
# Copyright (C) 2016-2017, Solidrun, Eric Bree <eric.bree@solid-run.com>
# SPDX-License-Identifier:	MIT

# We have a conf and classes directory, add to BBPATH
BBPATH =. "${LAYERDIR}:"

# We have recipes-* directories, add to BBFILES
BBFILES += "${LAYERDIR}/recipes-*/*/*.bb \
            ${LAYERDIR}/recipes-*/*/*.bbappend"

BBFILE_COLLECTIONS += "sr-in6gsdl"
BBFILE_PATTERN_sr-in6gsdl = "^${LAYERDIR}/"
BBFILE_PRIORITY_sr-in6gsdl = "13"

# This should only be incremented on significant changes that will
# cause compatibility issues with other layers
LAYERVERSION_sr-in6gsdl = "1"
LAYERDEPENDS_sr-in6gsdl = "cip-common"

LAYERSERIES_COMPAT_sr-in6gsdl = "dunfell warrior morty"

# Should be in meta-cip-common/conf/layer.conf, this is a workaround to avoid changing files in
# meta-cip-common
LAYERSERIES_COMPAT_cip-common = "dunfell warrior morty"
```

## poky/meta-cip-sr-n6gq/conf/layer.conf
```bitbake
# Copyright (C) 2016-2017, Solidrun, Eric Bree <eric.bree@solid-run.com>
# SPDX-License-Identifier:	MIT

# We have a conf and classes directory, add to BBPATH
BBPATH =. "${LAYERDIR}:"

# We have recipes-* directories, add to BBFILES
BBFILES += "${LAYERDIR}/recipes-*/*/*.bb \
            ${LAYERDIR}/recipes-*/*/*.bbappend"

BBFILE_COLLECTIONS += "sr-n6gq"
#BBFILE_PATTERN_sr-n6gq = "^${LAYERDIR}/"
BBFILE_PATTERN_sr-n6gq = ""
BBFILE_PRIORITY_sr-n6gq = "13"

# This should only be incremented on significant changes that will
# cause compatibility issues with other layers
LAYERVERSION_sr-n6gq = "1"
LAYERDEPENDS_sr-n6gq = "cip-common"

LAYERSERIES_COMPAT_sr-n6gq = "dunfell warrior morty"

# Should be in meta-cip-common/conf/layer.conf, this is a workaround to avoid changing files in
# meta-cip-common
LAYERSERIES_COMPAT_cip-common = "dunfell warrior morty"
```

## poky/meta-cip-sr-solidsense/conf/layer.conf
```bitbake
# Copyright (C) 2016-2017, TOSHIBA Corp., Daniel Sangorrin <daniel.sangorrin@toshiba.co.jp>
# SPDX-License-Identifier:      MIT

# We have a conf and classes directory, add to BBPATH
BBPATH =. "${LAYERDIR}:"

# We have recipes-* directories, add to BBFILES
BBFILES += "${LAYERDIR}/recipes-*/*/*.bb \
            ${LAYERDIR}/recipes-*/*/*.bbappend"

BBFILE_COLLECTIONS += "sr-solidsense"
BBFILE_PATTERN_sr-solidsense = "^${LAYERDIR}/"
BBFILE_PRIORITY_sr-solidsense = "13"

# This should only be incremented on significant changes that will
# cause compatibility issues with other layers
LAYERVERSION_sr-solidsense = "1"
LAYERDEPENDS_sr-solidsense = "cip-common"

LAYERSERIES_COMPAT_sr-solidsense = "warrior morty"

# Should be in meta-cip-common/conf/layer.conf, this is a workaround to avoid changing files in
# meta-cip-common
LAYERSERIES_COMPAT_cip-common = "warrior morty"
```

## poky/meta-cip-sr-solidsense/conf/machine/solidsense.conf
```bitbake
#@TYPE: Machine
#@NAME: Solidrun Solidsense
#@DESCRIPTION: Machine configuration for running on Solidsense

DEFAULTTUNE = "cortexa9thf-neon"
require conf/machine/include/tune-cortexa9.inc

IMAGE_FSTYPES ?= "tar.gz"

# U-boot related variables
EXTRA_IMAGEDEPENDS += "u-boot"
UBOOT_MACHINE = "mx6cuboxi_defconfig"
UBOOT_SUFFIX = "img"
BOOTLOADER_GIT_PROTOCOL = "https"
BOOTLOADER_GIT_URI = "git://github.com"
BOOTLOADER_GIT_PREFIX = "SolidRun/"
UBOOT_GIT_REPO = "${BOOTLOADER_GIT_URI}/${BOOTLOADER_GIT_PREFIX}u-boot.git;branch=v2018.01-solidrun-imx6;protocol=${BOOTLOADER_GIT_PROTOCOL}"

# Linux kernel related variables
LINUX_GIT_PROTOCOL = "https"
LINUX_GIT_URI = "git://github.com"
LINUX_GIT_REPO = "linux-stable.git"
LINUX_GIT_PREFIX = "SolidRun/"
LINUX_GIT_SRCREV = "linux-4.9.y-imx6"
LINUX_GIT_BRANCH = "linux-4.9.y-imx6"
LINUX_DEFCONFIG = "imx_v7_cbi_hb_defconfig"
KERNEL_DEVICETREE = "imx6dl-hummingboard2-emmc-som-v15.dtb imx6q-hummingboard2-emmc-som-v15.dtb"
KERNEL_IMAGETYPE = "zImage"

MACHINE_FEATURES += "pci wifi bluetooth irda serial usbhost"
MACHINE_EXTRA_RRECOMMENDS += "firmware-wireless-wilink8 kernel-firmware-sdma-imx6q"

MACHINE_HAS_VIVANTE_KERNEL_DRIVER_SUPPORT = "1"
MACHINE_USES_VIVANTE_KERNEL_DRIVER_MODULE = "0"

SERIAL_CONSOLE = "115200 ttymxc0"
SERIAL_CONSOLES = "115200;ttymxc0"

# Mender config
MENDER_STORAGE_DEVICE = "/dev/mmcblk2"
# actually size 7456, added 2 to ensure partitions are correctly made
MENDER_STORAGE_TOTAL_SIZE_MB = "7458"
ARTIFACTIMG_FSTYPE = "ext4"
SDIMG_ROOTFS_TYPE = "ext4"
IMAGE_ROOTFS_SIZE = "1524"

MENDER_PARTITION_ALIGNMENT = "1048576"
MENDER_BOOT_PART = ""
MENDER_BOOT_PART_SIZE_MB = "0"
# Use mender SWAP variables to set aside partition for overlayfs
MENDER_SWAP_PART_SIZE_MB = "64"
MENDER_ROOTFS_PART_A = "${MENDER_STORAGE_DEVICE_BASE}1"
MENDER_ROOTFS_PART_B = "${MENDER_STORAGE_DEVICE_BASE}2"
MENDER_DATA_PART = "${MENDER_STORAGE_DEVICE_BASE}4"
MENDER_DATA_PART_SIZE_MB = "4343"
MENDER_PARTITIONING_OVERHEAD_KB = "0"

MENDER_SERVER_URL = "https://mender.solidsense.io"
FILESEXTRAPATHS_prepend_pn-mender := "${TOPDIR}/../meta-cip-sr-solidsense/mender-cert:"
SRC_URI_append_pn-mender = " file://artifact-verify-key.pem"
MENDER_UBOOT_ENV_STORAGE_DEVICE_OFFSET = ""
MENDER_UBOOT_ENV_STORAGE_DEVICE_OFFSET_1 = "0xFE000"
MENDER_UBOOT_ENV_STORAGE_DEVICE_OFFSET_2 = "0xFC000"
BOOTENV_SIZE = "8192"
MENDER_DATA_PART_FSTAB_OPTS = "defaults"
MENDER_DATA_PART_FSTYPE = "ext4"
```
